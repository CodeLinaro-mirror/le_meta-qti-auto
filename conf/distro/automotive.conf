## conf/distro/automotive.conf
```bitbake
require ${COREBASE}/meta-agl/meta-agl-distro/conf/distro/poky-agl.conf
INHERIT_remove = "uninative"
INITRAMFS_FSTYPES = "cpio.gz"
USER_CLASSES = "buildname image-mklibs"

BASEDISTRO ?= "msm"
include conf/distro/msm.conf

DISTRO_NAME = "automotive"
DISTROOVERRIDES =. "automotive:"

PRODUCT = "automotive"

DEPLOY_NAME_BASE="${MACHINE}-automotive"

# Support systemd-user-session
DISTRO_FEATURES_append = " pam"
# Display
DISTRO_FEATURES_append = " wayland"

# Smack
OVERRIDES .= ":smack"
DISTRO_FEATURES_append = " smack dbus-cynara xattr"

# Use synergy, disable bluez
DISTRO_FEATURES_remove = " bluez5 bluetooth"

#Enable persist-image
DISTRO_FEATURES_append = " persist-image "
PERSIST_IMAGE_ROOTFS_SIZE ?= "32M"
```

## conf/distro/include/user_permissions.inc
```bitbake
USERADD_PACKAGES ?= "${PN}"

USERADD_PARAM:${PN} ?= 	" \
			-u 5002 -U leprop; \
			-u 1000 -U system; \
			-u 1001 -U radio; \
			-u 1004 -g input input; \
			-G diag,system -u 1005 -g audio audio; \
			-u 1010 -U wifi; \
			-u 1036 -U logd; \
			-u 2000 -U adb; \
			-G diag,inet,system,leprop -u 3011 -U sensors; \
			-u 9999 -U nobody; \
			-u 4021 -U locclient; \
			-G system,locclient -u 1021 -U gps; \
			-u 3014 -U powermgr; \
			-u 3015 -U ubi; \
			-u 2906 -U qrtr; \
			-u 3019 -U mvm; \
			"

GROUPADD_PARAM:${PN} ?=	" \
                        -g 2901 kmsg; \
			-g 3004 net_raw; \
			-g 3005 net_admin; \
			-g 3010 wakelock; \
			-g 3013 qwes; \
			-g 3018 gpio; \
			-g 3017 cpu; \
			-r netdev; \
			"
```

## conf/layer.conf
```bitbake
BBPATH .= ":${LAYERDIR}"
BBFILE_COLLECTIONS           += "qti-auto"
BBFILE_PRIORITY_qti-auto      = "12"
BBFILE_PATTERN_qti-auto      := "^${LAYERDIR}/"

LAYERSERIES_COMPAT_qti-auto = "dunfell kirkstone scarthgap"

BBFILES += " ${LAYERDIR}/recipes-*/*/*.bb \
             ${LAYERDIR}/recipes-*/*/*.bbappend"

LICENSE_PATH += "${LAYERDIR}/files/common-licenses"
```

## conf/machine/8155auto.conf
```bitbake
#@TYPE: Machine
#@NAME: 8155auto
#@DESCRIPTION: Machine configuration for QTI 8155auto

BASEMACHINE ?= "8155auto"
include conf/machine/include/auto-common.inc

# EMMC TARGET TO SUPPORT 64-bit kernel
DISTRO = "automotive"
DEFAULTTUNE = "aarch64"
MACHINE_FEATURES += "dt-overlay"

# Sizes for EXT4 (in bytes)
SYSTEM_SIZE_EXT4 ?= "100000000"
SYSTEMRW_SIZE_EXT4 ?= "8388608"
USERDATA_SIZE_EXT4 ?= "2000000000"
CACHE_SIZE_EXT4 ?= "80000000"

# Formats of root filesystem images.
IMAGE_FSTYPES += "ext4"
RECOVERY_IMAGE = "0"

KERNEL_CONFIG = "${@['sa8155-perf_defconfig', 'sa8155_defconfig'][d.getVar('VARIANT', True) == ('' or 'debug')]}"

KERNEL_CMD_PARAMS = "console=ttyMSM0,115200n8 earlycon=msm_geni_serial,0xa90000 androidboot.hardware=qcom androidboot.console=ttyMSM0 androidboot.memcg=1 lpm_levels.sleep_disabled=1 video=vfb:640x400,bpp=32,memsize=3072000 msm_rtb.filter=0x237 service_locator.enable=1 androidboot.usbcontroller=a600000.dwc3 androidboot.selinux=permissive buildvariant=userdebug root=/dev/sda6"

KERNEL_IMAGETYPE = "Image.gz-dtb"
IMAGE_EXT4_EXTRA_OPTIONS = "${@bb.utils.contains('DISTRO_FEATURES','ro-rootfs',' -J -b 1024 ','',d)}"

require conf/multilib.conf
MULTILIBS = "multilib:lib32"
DEFAULTTUNE_virtclass-multilib-lib32 = "armv7ahf-neon"

#BBMASK = "meta-qti-bsp/recipes-products/images/machine-image.bb"
#BBMASK_append = "|meta-qti-bsp/recipes-kernel/lk/lk_git.bb"
```

## conf/machine/include/auto-common.inc
```bitbake
include conf/machine/include/basemachine.inc

SOC_FAMILY ?= "sa8155"
include conf/machine/include/soc-family.inc

# Pull in security flags
require ${COREBASE}/meta-qti-bsp/conf/distro/include/security_flags.inc

include conf/machine/include/arm/arch-armv8.inc

PREFERRED_PROVIDER_virtual/kernel = "linux-msm"
PREFERRED_VERSION_linux-msm = "4.14"

# Prefer tcpdump 4.9.x by default
PREFERRED_VERSION_tcpdump              ?= "4.9.%"

# Wayland/Weston
PREFERRED_VERSION_weston = "1.9.0"
PREFERRED_VERSION_wayland = "1.9.0"
PREFERRED_VERSION_wayland-native = "1.9.0"
PREFERRED_VERSION_wayland-ivi-extension = "1.9.1"

# Prefer GStreamer 1.8.x by default
PREFERRED_VERSION_gstreamer1.0              ?= "1.8.%"
PREFERRED_VERSION_gstreamer1.0-plugins-bad  ?= "1.8.%"
PREFERRED_VERSION_gstreamer1.0-plugins-base ?= "1.8.%"
PREFERRED_VERSION_gstreamer1.0-plugins-good ?= "1.8.%"
PREFERRED_VERSION_gstreamer1.0-plugins-ugly ?= "1.8.%"
PREFERRED_VERSION_gstreamer1.0-libav        ?= "1.8.%"
PREFERRED_VERSION_gstreamer1.0-omx          ?= "1.2.%"

# Prefer iproute2
PREFERRED_VERSION_iproute2         ?= "4.11"

LICENSE_FLAGS_WHITELIST = "commercial_gstreamer1.0-libav commercial_gstreamer1.0-omx"
LICENSE_FLAGS_WHITELIST += "commercial_gstreamer1.0-plugins-ugly commercial_opencore-amr"
LICENSE_FLAGS_WHITELIST += "commercial_libomxil"



MACHINE_DISPLAY_WIDTH_PIXELS ?= "480"
MACHINE_DISPLAY_HEIGHT_PIXELS ?= "640"

SERIAL_CONSOLE ?= "${@['', '115200 ttyMSM0'][d.getVar('VARIANT', True) == ('' or 'debug')]}"

DISTRO ?= "automotive"

EXTRA_IMAGE_FEATURES = "tools-debug"

# DISTRO_FEATURES_append = " ro-rootfs"

# Use systemd init manager.
DISTRO_FEATURES_remove = "sysvinit"
DISTRO_FEATURES_append = " systemd"
DISTRO_FEATURES_BACKFILL_CONSIDERED += "sysvinit"
VIRTUAL-RUNTIME_dev_manager = "udev"
VIRTUAL-RUNTIME_init_manager = "systemd"

# Change Image features for systemd.
IMAGE_DEV_MANAGER = "udev"
IMAGE_INIT_MANAGER = "systemd"
IMAGE_INITSCRIPTS = ""

PAGE_SIZE ?= '4096'

MACHINE_FEATURES += "kernel26 keyboard"
```

## conf/machine/include/bbmask.inc
```bitbake
#BBMASK = "meta-qti-bsp/recipes-kernel/lk/lk_git.bb"
#BBMASK .= "|meta-selftest/recipes-test/container-image/cc.bb"

#Display bbmask
BBMASK = "meta-qti-display/recipes-products/images/machine-qsap-image.bbappend"
BBMASK .= "|meta-qti-display/recipes-products/images/automotive-image.bbappend"
BBMASK .= "|meta-qti-display/recipes/wayland/weston_1.9.0.bbappend"
BBMASK .= "|meta-qti-display/recipes-products/images/machine-minimal-image.bbappend"

BBMASK .= "|meta-agl/meta-agl/recipes-graphics/wayland/"
BBMASK .= "|meta-agl/meta-ivi-common/recipes-graphics/wayland/"
BBMASK .= "|meta-agl-demo/recipes-graphics/wayland/"
BBMASK .= "|meta-agl/meta-ivi-common/recipes-test/wayland/"
BBMASK .= "|meta-agl/meta-app-framework/recipes-kernel/linux/linux-yocto_4.1.bbappend"
BBMASK .= "|meta-agl/meta-agl/recipes-devtools/autogen/autogen-native_5.18.12.bbappend"
BBMASK .= "|meta-agl/meta-agl/recipes-connectivity/connman/"
BBMASK .= "|meta-agl/meta-agl/recipes-connectivity/rygel/"
BBMASK .= "|meta-agl/meta-agl/recipes-core/psplash/"
BBMASK .= "|meta-agl/meta-ivi-common/recipes-test/freetype/"
BBMASK .= "|meta-agl-demo/recipes-support/opencv/"
BBMASK .= "|meta-agl-demo/recipes-qt/qt5/qtmultimedia_%.bbappend"
BBMASK .= "|meta-agl-demo/recipes-core/packagegroups/"

BBMASK .= "|meta-qti-bsp/recipes-devtools/gdb/gdb_%.bbappend"
BBMASK .= "|meta-qti-bsp/recipes-core/systemd/systemd_%.bbappend"
BBMASK .= "|meta-qti-bsp/recipes-core/volatile-binds/volatile-binds.bbappend"

BBMASK .= "|meta-qti-data/recipes/iproute2/"
BBMASK .= "|meta-qti-data/recipes/avahi/"
```

## conf/machine/include/sa525m-apq.inc
```bitbake
MACHINE_FEATURES:append = " qti-eap"
MACHINE_FEATURES:remove += "qti-wwan-plus-cv2x qti-cv2x-compensator qti-mvm qti-location qti-wlan qti-nad-telaf"
USBCOMPOSITION = "901D"
SDCARD_DEVICE:sa525m = "mmcblk1"

FLAVOR = "apq"
SYSTEMD_AUTO_ENABLE:modem-monitor = "enable"
```

## conf/machine/include/telematics-hostvm.inc
```bitbake
MACHINE_FEATURES:append = " qti-vm-host qti-virtualization"

MACHINE_MNT_POINTS = " \
    /firmware \
    /systemrw \
    /persist \
    /data \
    /vm-bootsys \
    /vm_systemrw \
"

KERNEL_VARIANT:qti-distro-debug ??= "hostvm_debug_"
KERNEL_VARIANT:qti-distro-perf ??= "hostvm_perf_"

MACHINE_FEATURES:remove = "qti-wwan-plus-cv2x"
```

## conf/machine/include/telematics-minimal.inc
```bitbake
KERNEL_VARIANT:qti-distro-debug ??= "minimal_debug_"
KERNEL_VARIANT:qti-distro-perf ??= "minimal_perf_"

MACHINE_FEATURES:remove += "qti-wwan-plus-cv2x qti-cv2x-compensator qti-sensors qti-bluetooth qti-audio qti-location qti-wlan qti-tele-lxc qti-nad-fde"

FLAVOR = "minimal"

RDEPENDS:packagegroup-qti-data:remove = " \
	modem-monitor \
"
```

## conf/machine/mdm9607.conf
```bitbake
require ${COREBASE}/meta-qti-bsp/conf/machine/mdm9607.conf
#DISTRO_FEATURES_append = " ntn-hsic-kern-mod"
```

## conf/machine/qtiquingvm.conf
```bitbake
#@TYPE: Machine
#@NAME: qtiquingvm
#@DESCRIPTION: Machine configuration for QTI QUIN

BASEMACHINE ?= "qtiquingvm"
include conf/machine/include/auto-common.inc
include conf/machine/include/bbmask.inc

SERIAL_CONSOLE = "115200 ttyAMA0"

# EMMC TARGET TO SUPPORT 64-bit kernel
DISTRO = "automotive"
DEFAULTTUNE = "aarch64"

# Sizes for EXT4 (in bytes)
SYSTEM_SIZE_EXT4 ?= "100000000"
SYSTEMRW_SIZE_EXT4 ?= "8388608"
USERDATA_SIZE_EXT4 ?= "2000000000"
CACHE_SIZE_EXT4 ?= "80000000"

# Formats of root filesystem images.
IMAGE_FSTYPES += "ext4"
RECOVERY_IMAGE = "0"

KERNEL_BASE = "0x80000000"
KERNEL_TAGS_OFFSET = "0x1e00000"
KERNEL_CONFIG = "${@['vendor/qti-quin-gvm-perf_defconfig', 'vendor/qti-quin-gvm_defconfig'][d.getVar('VARIANT', True) == ('' or 'debug')]}"
KERNEL_CMD_PARAMS = " "
KERNEL_IMAGETYPE = "Image-dtb"

IMAGE_EXT4_EXTRA_OPTIONS = "${@bb.utils.contains('DISTRO_FEATURES','ro-rootfs',' -J -b 1024 ','',d)}"

require conf/multilib.conf
MULTILIBS = "multilib:lib32"
DEFAULTTUNE_virtclass-multilib-lib32 = "armv7ahf-neon"
DISTRO_FEATURES_append= " ab-boot-support"

BBMASK += "meta-qti-auto/recipes-agl/dbus/dbus-glib_%.bbappend"
BBMASK += "meta-qti-auto/recipes-agl/dbus/dbus_%.bbappend"
BBMASK += "meta-qti-auto/recipes-agl/dbus/libdbus-c\+\+_0.9.0.bbappend"
BBMASK += "meta-qti-auto/recipes-agl/lightmediascanner/lightmediascanner_0.5.1.bb"
BBMASK += "meta-qti-auto/recipes-agl/connman/connman-conf.bbappend"
BBMASK += "meta-qti-auto/recipes-agl/connman/connman_%.bbappend"
BBMASK += "meta-qti-auto/recipes-agl/opencv/opencv_3.3.bbappend"
BBMASK += "meta-qti-auto/recipes-agl/udisks/udisks_1.0.5.bbappend"
BBMASK += "meta-qti-auto/recipes-agl/dbus-cynara/dbus-cynara_1.10.20.bb"
BBMASK += "meta-qti-auto/recipes-agl/dbus-cynara/dbus-cynara_%.bbappend"
BBMASK += "meta-qti-auto/recipes-agl/bash-completion/bash-completion_%.bbappend"
BBMASK += "meta-qti-auto/recipes-agl/agl-login-manager/agl-login-manager_0.1.bbappend"
BBMASK += "meta-qti-auto/recipes-agl/agl-users/agl-users_0.1.bbappend"
BBMASK += "meta-qti-auto/recipes-agl/cynara/cynara_%.bbappend"
BBMASK += "meta-qti-auto/recipes-agl/navigation/navigation_%.bbappend"
BBMASK += "meta-qti-auto/recipes-agl/packagegroup/packagegroup-agl-appfw-graphics.bbappend"
BBMASK += "meta-qti-auto/recipes-agl/packagegroup/packagegroup-agl-appfw-native-qt5.bbappend"
BBMASK += "meta-qti-auto/recipes-agl/packagegroup/packagegroup-agl-demo-platform.bbappend"
BBMASK += "meta-qti-auto/recipes-agl/packagegroup/packagegroup-agl-demo.bbappend"
BBMASK += "meta-qti-auto/recipes-agl/packagegroup/packagegroup-agl-ivi-connectivity.bbappend"
BBMASK += "meta-qti-auto/recipes-agl/packagegroup/packagegroup-ivi-common-core-graphics.bbappend"
BBMASK += "meta-qti-auto/recipes-agl/phone/phone_git.bbappend"
BBMASK += "meta-qti-auto/recipes-agl/run-agl-postinsts/run-agl-postinsts_1.0.bbappend"
BBMASK += "meta-qti-auto/recipes-agl/security-manager/security-manager_%.bbappend"
```

## conf/machine/sa510m-1G.conf
```bitbake
#@TYPE: Machine
#@NAME: SA510M-1G
#@DESCRIPTION: Machine configuration for SA510M NAND

require conf/machine/include/sa510m.inc

# MACHINE_FEATURES ##
# qti-wcs: Machine supports QTI Wifi Connection Security solution
MACHINE_FEATURES += "nand-boot qti-nad-core qti-recoveryinfo qti-wcs qti-nad-fde qti-nad-mrc"

# Formats of root filesystem images
IMAGE_FSTYPES = "ubi"

# Sizes for UBI volumes
SYSTEM_VOLUME_SIZE = "135MiB"
CACHE_VOLUME_SIZE    = "10MiB"
SYSTEMRW_VOLUME_SIZE = "6MiB"
PERSIST_VOLUME_SIZE  = "4MiB"
MODEM_VOLUME_SIZE = "52MiB"

# Sizes for UBI squashfs volumes
SYSTEM_SQUASHFS_VOLUME_SIZE = "${@bb.utils.contains('DEBUG_BUILD', '1', '90MiB', '80MiB', d)}"
MODEM_SQUASHFS_VOLUME_SIZE = "95MiB"

# UBI arguments
UBINIZE_ARGS = "-m 4096 -p 256KiB -s 4096"
MKUBIFS_ARGS = "-m 4096 -e 253952 -c 2146 -F"
MKUBIFS_USERFS_ARGS = "-m 4096 -e 253952 -c 6144 -F"

# File indicating firmware residing places on device.
MACHINE_FILESMAP_CONF = "sa510m-filesmap"

MACHINE_FSCONFIG_CONF = "sa525m-emmc-fsconfig.conf"
KERNEL_CMD_PARAMS += "mem=832M"
```

## conf/machine/sa510m.conf
```bitbake
#@TYPE: Machine
#@NAME: SA510M
#@DESCRIPTION: Machine configuration for SA510M NAND

require conf/machine/include/sa510m.inc

# MACHINE_FEATURES ##
MACHINE_FEATURES += "nand-boot qti-nad-core qti-nad-mrc"

# Formats of root filesystem images
IMAGE_FSTYPES = "ubi"

# Sizes for UBI volumes
SYSTEM_VOLUME_SIZE = "115MiB"
CACHE_VOLUME_SIZE    = "10MiB"
SYSTEMRW_VOLUME_SIZE = "6MiB"
PERSIST_VOLUME_SIZE  = "4MiB"
MODEM_VOLUME_SIZE = "60MiB"

# Sizes for UBI squashfs volumes
SYSTEM_SQUASHFS_VOLUME_SIZE = "${@bb.utils.contains('DEBUG_BUILD', '1', '85MiB', '80MiB', d)}"
MODEM_SQUASHFS_VOLUME_SIZE = "45MiB"

# UBI arguments
UBINIZE_ARGS = "-m 4096 -p 256KiB -s 4096"
MKUBIFS_ARGS = "-m 4096 -e 253952 -c 2146 -F"
MKUBIFS_USERFS_ARGS = "-m 4096 -e 253952 -c 6144 -F"

# File indicating firmware residing places on device.
MACHINE_FILESMAP_CONF = "sa510m-filesmap"

MACHINE_FSCONFIG_CONF = "sa525m-emmc-fsconfig.conf"

MACHINE_SUPPORTS_DISPLAY = "False"
```

## conf/machine/sa525m-emmc.conf
```bitbake
#@TYPE: Machine
#@NAME: SA525M-EMMC
#@DESCRIPTION: Machine configuration for SA525M EMMC

require conf/machine/include/sa525m.inc

# MACHINE_FEATURES ##
MACHINE_FEATURES += "emmc-boot qti-ab-boot qti-nad-core ckmhal_kmlite qti-stream-update"

# Sizes for EXT4 (in bytes)
SYSTEM_SIZE_EXT4  = "309329920"
USERDATA_SIZE_EXT4 = "251658240"
CACHE_SIZE_EXT4 = "26214400"
SYSTEMRW_SIZE_EXT4 = "8192000"
PERSIST_SIZE_EXT4  = "6291456"

SDCARD_DEVICE = "mmcblk1p1"
SLOT_A_SUFFIX = ""

# Formats of root filesystem images
IMAGE_FSTYPES += "ext4"
#MACHINE_SUPPORTS_INIT_RAMDISK = "True"
#TOYBOX_RAMDISK = "True"
MACHINE_FSCONFIG_CONF = "sa525m-emmc-fsconfig.conf"

# File indicating firmware residing places on device.
MACHINE_FILESMAP_CONF = "sa525m-emmc-filesmap"

MACHINE_PARTITION_CONF = "sa525m-partition.conf"

MACHINE_FEATURES:remove += "qti-recovery qti-nad-telaf"

FLAVOR = "pvm"
```

## conf/machine/sa525m.conf
```bitbake
#@TYPE: Machine
#@NAME: SA525M
#@DESCRIPTION: Machine configuration for SA525M NAND

require conf/machine/include/sa525m.inc

# MACHINE_FEATURES ##
MACHINE_FEATURES += "nand-boot tele-squashfs-ubi ckmhal_kmlite"

# Formats of root filesystem images
IMAGE_FSTYPES = "ubi"

# Sizes for UBI volumes
SYSTEM_VOLUME_SIZE   = "140MiB"
CACHE_VOLUME_SIZE    = "10MiB"
SYSTEMRW_VOLUME_SIZE = "6MiB"
PERSIST_VOLUME_SIZE  = "6MiB"
MODEM_VOLUME_SIZE = "110MiB"
VM_BOOTSYS_VOLUME_SIZE = "128MiB"

# Sizes for UBI squashfs volumes
SYSTEM_SQUASHFS_VOLUME_SIZE = "80MiB"
MODEM_SQUASHFS_VOLUME_SIZE = "95MiB"
TELAF_SQUASHFS_VOLUME_SIZE = "10MiB"
TELAF_APP_VOLUME_SIZE = "20MiB"
VM_BOOTSYS_SQUASHFS_VOLUME_SIZE = "80MiB"

# UBI arguments
UBINIZE_ARGS = "-m 4096 -p 256KiB -s 4096"
MKUBIFS_ARGS = "-m 4096 -e 253952 -c 2146 -F"
MKUBIFS_USERFS_ARGS = "-m 4096 -e 253952 -c 6144 -F"

# Disable autosuspend for USB peripheral mode
MACHINE_SUPPORTS_USB_AUTOSUSPEND = "False"

# File indicating firmware residing places on device.
MACHINE_FILESMAP_CONF = "sa525m-filesmap"

MACHINE_FSCONFIG_CONF = "sa525m-emmc-fsconfig.conf"
```
