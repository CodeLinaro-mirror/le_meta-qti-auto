## conf/machine/sa8155.conf
```bitbake
#@TYPE: Machine
#@NAME: sa8155
#@DESCRIPTION: Machine configuration for QTI sa8155

BASEMACHINE ?= "sa8155"
include conf/machine/include/auto-common.inc
include conf/machine/include/bbmask.inc

# EMMC TARGET TO SUPPORT 64-bit kernel
DISTRO = "automotive"
DEFAULTTUNE = "aarch64"
MACHINE_FEATURES += "dt-overlay"

# Sizes for EXT4 (in bytes)
SYSTEM_SIZE_EXT4 ?= "100000000"
SYSTEMRW_SIZE_EXT4 ?= "8388608"
USERDATA_SIZE_EXT4 ?= "2000000000"
CACHE_SIZE_EXT4 ?= "80000000"

# Formats of root filesystem images.
IMAGE_FSTYPES += "ext4"
RECOVERY_IMAGE = "0"

KERNEL_BASE = "0x80000000"
KERNEL_TAGS_OFFSET = "0x1e00000"
KERNEL_CONFIG = "${@['vendor/sa8155-perf_defconfig', 'vendor/sa8155_defconfig'][d.getVar('VARIANT', True) == ('' or 'debug')]}"
KERNEL_CMD_PARAMS = "console=ttyMSM0,115200n8 earlycon=msm_geni_serial,0xa90000 androidboot.hardware=qcom androidboot.console=ttyMSM0 androidboot.memcg=1 lpm_levels.sleep_disabled=1 video=vfb:640x400,bpp=32,memsize=3072000 msm_rtb.filter=0x237 service_locator.enable=1 androidboot.usbcontroller=a600000.dwc3 androidboot.selinux=permissive androidboot.slot_suffix=_a buildvariant=userdebug root=/dev/sda6 rootfstype=ext4 rw rootwait firmware_class.path=/firmware/image/ "
KERNEL_CMD_PARAMS_append = " fsck.repair=yes "
KERNEL_CMD_PARAMS_remove = "${@bb.utils.contains_any('VARIANT', 'perf user', 'console=ttyMSM0,115200n8', '', d)}"
KERNEL_CMD_PARAMS_remove = "${@bb.utils.contains_any('VARIANT', 'perf user', 'earlycon=msm_geni_serial,0xa90000', '', d)}"
KERNEL_CMD_PARAMS_remove = "${@bb.utils.contains_any('VARIANT', 'perf user', 'androidboot.console=ttyMSM0', '', d)}"
KERNEL_CMD_PARAMS_remove = "${@bb.utils.contains('DISTRO_FEATURES', 'selinux', '', 'androidboot.selinux=permissive', d)}"
KERNEL_CMD_PARAMS_remove = "${@bb.utils.contains('IMAGE_FEATURES', 'read-only-rootfs', 'rw', '', d)}"
KERNEL_IMAGETYPE = "Image-dtb"

IMAGE_EXT4_EXTRA_OPTIONS = "${@bb.utils.contains('DISTRO_FEATURES','ro-rootfs',' -J -b 1024 ','',d)}"

require conf/multilib.conf
MULTILIBS = "multilib:lib32"
DEFAULTTUNE_virtclass-multilib-lib32 = "armv7ahf-neon"
DISTRO_FEATURES += " ab-boot-support"
```
